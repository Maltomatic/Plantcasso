/**
 * plant_inference.ino  —  PlantCasso ESP32-S3
 * ============================================
 * Real-time plant bioelectric signal → K-means cluster → 5-DOF servo arm.
 *
 * Workflow (triggered every HOP_SIZE=30 new samples = every 300 ms at 100 Hz):
 *
 *   ADC (12-bit, 3.3 V)
 *     → Biquad IIR lowpass  (30 Hz, 4th-order Butterworth, 2 × Direct-Form-II)
 *     → Circular window buffer (WINDOW_SIZE = 100 samples)
 *     → 9 FFT-free features    (matches pipeline/01_filter_extract.py exactly)
 *     → StandardScaler         (subtract SCALER_MEAN, divide by SCALER_STD)
 *     → PCA projection         (9D → 3D via PCA_COMPONENTS dot product)
 *     → K-means nearest centroid
 *     → Servo angle mapping + exponential smoothing
 *
 * Servo mapping:
 *   Joint 0 (shoulder)    ← PC1   (slow, smooth — overall state)
 *   Joint 1 (elbow)       ← PC2
 *   Joint 2 (wrist tilt)  ← PC3
 *   Joint 3 (wrist rotate)← spike_count        (snappy — transient spikes)
 *   Joint 4 (gripper)     ← hjorth_complexity  (chaos / waveform irregularity)
 *
 * Prerequisites:
 *   • model_params.h in the same directory (generated by pipeline/02_train.py)
 *   • Arduino-ESP32 core ≥ 2.0
 *   • Adafruit_PWMServoDriver library (install via Arduino Library Manager)
 *   • Wire (built-in)
 *
 * Adjust PIN_PLANT and SERVO_CHANNELS to match your wiring.
 */

#include <Arduino.h>
#include <Wire.h>
#include <Adafruit_PWMServoDriver.h>
#include <array>
#include <cmath>
#include <cstdint>
#include "model_params.h"

static constexpr int PIN_PLANT       = 11;
static constexpr int PIN_SDA = 1;
static constexpr int PIN_SCL = 2;

// PCA9685 I2C servo driver (addr 0x40) — channels 0-4 map to joints 0-4 (SDA=1, SCL=2)

static constexpr std::array<int, 5> SERVO_CHANNELS = {0, 1, 2, 3, 4}; // PCA9685 channel per joint
static constexpr uint16_t  SERVO_MIN_TK  = 102;    // ~0.5 ms pulse at 50 Hz
static constexpr uint16_t  SERVO_MAX_TK  = 512;    // ~2.5 ms pulse at 50 Hz

Adafruit_PWMServoDriver pwm = Adafruit_PWMServoDriver(0x40);

// Convert degrees [0, 180] → PCA9685 12-bit tick count
static uint16_t deg_to_pulse(float deg) noexcept {
    deg = (deg < 0.0f) ? 0.0f : (deg > 180.0f ? 180.0f : deg);
    return static_cast<uint16_t>(SERVO_MIN_TK + (deg / 180.0f) * (SERVO_MAX_TK - SERVO_MIN_TK) + 0.5f);
}

static constexpr uint32_t SAMPLE_US = 10'000UL;

// ─────────────────────────────────────────────────────────────────────────────
// Biquad IIR lowpass — Direct Form II (causal, 1 sample latency per section)
// BIQUAD_SOS rows from model_params.h: {b0, b1, b2, a1, a2}   (a0 = 1)
//
//   w[n] = x[n] - a1*w[n-1] - a2*w[n-2]
//   y[n] = b0*w[n] + b1*w[n-1] + b2*w[n-2]
// ─────────────────────────────────────────────────────────────────────────────
struct BiquadState { float w1{0.0f}, w2{0.0f}; };
static std::array<BiquadState, N_SOS> s_bq{};

static float biquad_process(float x) noexcept {
    for (int s = 0; s < N_SOS; ++s) {
        const float *c = BIQUAD_SOS[s];               // {b0, b1, b2, a1, a2}
        float w = x - c[3] * s_bq[s].w1 - c[4] * s_bq[s].w2;
        float y = c[0] * w + c[1] * s_bq[s].w1 + c[2] * s_bq[s].w2;
        s_bq[s].w2 = s_bq[s].w1;
        s_bq[s].w1 = w;
        x = y;
    }
    return x;
}

// ─────────────────────────────────────────────────────────────────────────────
// Circular window buffer — holds the last WINDOW_SIZE filtered samples.
// write_pos always points to where the NEXT sample will be written.
// After the buffer is full, oldest sample is at index write_pos.
// ─────────────────────────────────────────────────────────────────────────────
static std::array<float, WINDOW_SIZE> s_win_buf{};
static int      s_write_pos = 0;
static uint32_t s_n_written = 0;   // total samples ever written

// Copy circular buffer into dst[0..WINDOW_SIZE-1] in oldest→newest order.
static void linearise_window(float *dst) noexcept {
    for (int i = 0; i < WINDOW_SIZE; ++i)
        dst[i] = s_win_buf[(s_write_pos + i) % WINDOW_SIZE];
}

// ─────────────────────────────────────────────────────────────────────────────
// Feature extraction
// MUST match pipeline/01_filter_extract.py::extract_window() exactly.
//
// Feature indices (same order as SCALER_MEAN, SCALER_STD, etc.):
//   0  mean               DC / baseline voltage
//   1  std                overall amplitude variability
//   2  ptp                peak-to-peak (spike amplitude)
//   3  slope              linear drift within window
//   4  zcr                zero-crossing rate of demeaned signal
//   5  spike_count        local-maxima rate above mean + 2σ
//   6  hjorth_mobility    √(var(Δx) / var(x))
//   7  hjorth_complexity  mobility(Δx) / mobility(x)
//   8  rms_first_diff     √(mean(Δx²))  — high-freq content proxy
// ─────────────────────────────────────────────────────────────────────────────
static std::array<float, N_FEATURES> s_raw_feats{};
int raw_adc = 0;
float volts = 0.0;

static void extract_features(const float * __restrict__ w, int n) noexcept {
    const float fn  = static_cast<float>(n);
    const float fn1 = static_cast<float>(n - 1);
    const float fn2 = static_cast<float>(n - 2);

    // ── mean, min, max ────────────────────────────────────────────────────
    float sum = 0.0f, vmin = w[0], vmax = w[0];
    for (int i = 0; i < n; ++i) {
        sum += w[i];
        if (w[i] < vmin) vmin = w[i];
        if (w[i] > vmax) vmax = w[i];
    }
    const float mean = sum / fn;

    // ── std (population variance, ddof=0) ─────────────────────────────────
    float var_sum = 0.0f;
    for (int i = 0; i < n; ++i) {
        const float d = w[i] - mean;
        var_sum += d * d;
    }
    const float var_x = var_sum / fn + 1e-10f;
    const float std_v = sqrtf(var_x);

    // ── slope — analytical linear regression ──────────────────────────────
    // x̄ = (n−1)/2;  Σ(i − x̄)² = n·(n²−1)/12
    const float x_mean = (fn - 1.0f) * 0.5f;
    float xy = 0.0f;
    for (int i = 0; i < n; ++i)
        xy += (static_cast<float>(i) - x_mean) * (w[i] - mean);
    // Note: Σ(i−x̄)·(y_i−ȳ) = Σ(i−x̄)·y_i  since Σ(i−x̄)=0
    const float x_var2 = fn * (fn * fn - 1.0f) / 12.0f;
    const float slope  = xy / x_var2;

    // ── ptp ───────────────────────────────────────────────────────────────
    const float ptp = vmax - vmin;

    // ── zero-crossing rate on demeaned signal ─────────────────────────────
    int zc        = 0;
    int prev_sign = (w[0] - mean >= 0.0f) ? 1 : -1;
    for (int i = 1; i < n; ++i) {
        const int s = (w[i] - mean >= 0.0f) ? 1 : -1;
        if (s != prev_sign) { ++zc; prev_sign = s; }
    }
    const float zcr = static_cast<float>(zc) / fn;

    // ── spike count — sharpness-gated peaks ──────────────────────────────
    // A candidate peak must satisfy ALL of:
    //   (a) local maximum   (b) above mean + SPIKE_SIGMA * std
    //   (c) drops by >= SPIKE_SHARP * std within SPIKE_HALF_WIDTH samples
    //       on EACH side — this rejects slow fluctuations that happen to
    //       crest above the threshold but never come back down quickly.
    // Tune in 01_filter_extract.py and mirror the values here.
    static constexpr float SPIKE_SIGMA      = 1.5f;   // height threshold (σ)
    static constexpr float SPIKE_SHARP      = 0.5f;   // min drop each side (σ)
    static constexpr int   SPIKE_HALF_WIDTH = 3;      // samples — 30 ms @ 100 Hz

    const float thr = mean + SPIKE_SIGMA * std_v;
    int spikes = 0;
    for (int i = SPIKE_HALF_WIDTH; i < n - SPIKE_HALF_WIDTH; ++i) {
        if (w[i] > w[i-1] && w[i] > w[i+1] && w[i] > thr
                && w[i] - w[i - SPIKE_HALF_WIDTH] > SPIKE_SHARP * std_v
                && w[i] - w[i + SPIKE_HALF_WIDTH] > SPIKE_SHARP * std_v)
            ++spikes;
    }
    const float spike_count = static_cast<float>(spikes) / fn;

    // ── Hjorth parameters — single-pass via E[x²]−E[x]² identity ─────────
    // var(dx)  = mean(dx²)  − mean(dx)²   (population variance, ddof=0)
    // var(d²x) = mean(d²x²) − mean(d²x)²
    float dx_sum  = 0.0f, dx_sq_sum  = 0.0f;
    float d2x_sum = 0.0f, d2x_sq_sum = 0.0f;

    for (int i = 0; i < n - 1; ++i) {
        const float dx = w[i+1] - w[i];
        dx_sum    += dx;
        dx_sq_sum += dx * dx;
        if (i < n - 2) {
            const float d2x = w[i+2] - 2.0f * w[i+1] + w[i];
            d2x_sum    += d2x;
            d2x_sq_sum += d2x * d2x;
        }
    }
    const float dx_mean  = dx_sum  / fn1;
    const float d2x_mean = d2x_sum / fn2;
    const float var_dx   = dx_sq_sum  / fn1 - dx_mean  * dx_mean  + 1e-10f;
    const float var_d2x  = d2x_sq_sum / fn2 - d2x_mean * d2x_mean + 1e-10f;

    const float rms_diff   = sqrtf(dx_sq_sum / fn1);
    const float mobility   = sqrtf(var_dx / var_x);
    const float complexity = sqrtf(var_d2x / var_dx) / mobility;

    // ── Store ─────────────────────────────────────────────────────────────
    s_raw_feats[0] = mean;
    s_raw_feats[1] = std_v;
    s_raw_feats[2] = ptp;
    s_raw_feats[3] = slope;
    s_raw_feats[4] = zcr;
    s_raw_feats[5] = spike_count;
    s_raw_feats[6] = mobility;
    s_raw_feats[7] = complexity;
    s_raw_feats[8] = rms_diff;
}

// ─────────────────────────────────────────────────────────────────────────────
// Rolling-mean baseline — ring buffer of the last N_MEAN_WINDOWS window means.
// Feature 0 (mean) becomes deviation from that local baseline:
//   - captures genuine state shifts  (e.g. plant responding to stimulus)
//   - rejects slow DC drift          (electrode offset changing over hours)
//
// N_MEAN_WINDOWS = 10 → baseline spans the last 10 × HOP_SIZE/FS seconds.
// Increase for slower adaptation (more drift tolerance, less state sensitivity).
// Must match N_MEAN_WINDOWS in pipeline/02_train.py.
// ─────────────────────────────────────────────────────────────────────────────
static constexpr int N_MEAN_WINDOWS = 10;
static float  s_mean_ring[N_MEAN_WINDOWS] = {};
static int    s_mean_ring_pos  = 0;    // next write position
static int    s_mean_ring_fill = 0;    // how many slots are filled
static float  s_mean_ring_sum  = 0.0f; // running sum for O(1) mean

// ─────────────────────────────────────────────────────────────────────────────
// Standardise + PCA project
// ─────────────────────────────────────────────────────────────────────────────
static float                         s_win_mean_v = 0.0f;  // raw window mean (V)
static std::array<float, N_FEATURES> s_scaled{};
static std::array<float, N_PCA>      s_pca{};

static void standardise_and_project() noexcept {
    // ── Rolling-mean baseline (ring buffer) ───────────────────────────────
    // Update ring: subtract oldest entry if full, insert current mean.
    if (s_mean_ring_fill == N_MEAN_WINDOWS)
        s_mean_ring_sum -= s_mean_ring[s_mean_ring_pos];  // evict oldest
    s_mean_ring[s_mean_ring_pos] = s_raw_feats[0];
    s_mean_ring_sum += s_raw_feats[0];
    s_mean_ring_pos = (s_mean_ring_pos + 1) % N_MEAN_WINDOWS;
    if (s_mean_ring_fill < N_MEAN_WINDOWS) ++s_mean_ring_fill;

    const float rolling_mean = s_mean_ring_sum / static_cast<float>(s_mean_ring_fill);
    s_win_mean_v    = s_raw_feats[0];  // save absolute window mean before subtraction
    s_raw_feats[0] -= rolling_mean;   // deviation from local N-window baseline

    for (int i = 0; i < N_FEATURES; ++i)
        s_scaled[i] = (s_raw_feats[i] - SCALER_MEAN[i]) / SCALER_STD[i]
                      * FEATURE_WEIGHTS[i];   // boost complexity (index 7) → 2×

    for (int p = 0; p < N_PCA; ++p) {
        float dot = 0.0f;
        for (int f = 0; f < N_FEATURES; ++f)
            dot += PCA_COMPONENTS[p][f] * s_scaled[f];
        s_pca[p] = dot;
    }
}

// ─────────────────────────────────────────────────────────────────────────────
// K-means — nearest centroid (squared Euclidean, avoids sqrtf)
// ─────────────────────────────────────────────────────────────────────────────
[[nodiscard]] static int find_cluster() noexcept {
    int   best      = 0;
    float best_dist = 1e30f;
    for (int k = 0; k < N_CLUSTERS; ++k) {
        float dist = 0.0f;
        for (int p = 0; p < N_PCA; ++p) {
            const float d = s_pca[p] - KMEANS_CENTROIDS[k][p];
            dist += d * d;
        }
        if (dist < best_dist) { best_dist = dist; best = k; }
    }
    return best;
}

// ─────────────────────────────────────────────────────────────────────────────
// Servo mapping + exponential smoothing

static constexpr float JOINT_MIN[5] = { 10.0f,  90.0f, 10.0f,  10.0f,  70.0f };
static constexpr float JOINT_MAX[5] = {170.0f, 120.0f, 90.0f, 80.0f, 110.0f };

// Number of linear traversals of [JOINT_MIN, JOINT_MAX] as the signal sweeps
// its full calibrated range.  0 = normal linear map.  S4 bounces 3× so that
// even small hjorth_complexity changes produce rapid left-right waving.
static constexpr int SERVO_BOUNCES[5] = {0, 3, 2, 0, 4};

// EMA alpha — applied every 100 Hz tick (not per window).
// Slow PCA joints settle over ~1-2 s; fast transient joints respond in ~200 ms.
static constexpr std::array<float, 5> SERVO_ALPHA = {0.10f, 0.06f, 0.02f, 0.02f, 0.10f};

static std::array<float, 5> s_servo_pos    = {90.0f, 90.0f, 10.0f, 10.0f, 90.0f};
static std::array<float, 5> s_target_pos   = {90.0f, 90.0f, 10.0f, 10.0f, 90.0f};

// Idle "breathing" oscillation — adds gentle life when plant is calm.
// Amplitude is small (< 8 °) so antagonized plant signals always dominate.
// Each joint uses a different frequency and phase to avoid lockstep motion.
static constexpr float IDLE_AMP[5]   = {  7.0f,  9.0f,  5.0f,  6.0f,  5.0f };  // degrees
static constexpr float IDLE_FREQ[5]  = {  0.29f, 0.17f, 0.23f, 0.37f, 0.31f }; // Hz
static constexpr float IDLE_PHASE[5] = {  0.0f,  1.1f,  2.3f,  3.7f,  5.1f };  // rad offset

// Map signal value v from calibrated range [lo, hi] to joint angle [out_min, out_max].
static float map_servo(float v, float lo, float hi, float out_min, float out_max) noexcept {
    if (hi - lo < 1e-6f) return (out_min + out_max) * 0.5f;
    float t = (v - lo) / (hi - lo);
    t = (t < 0.0f) ? 0.0f : (t > 1.0f ? 1.0f : t);
    return out_min + t * (out_max - out_min);
}

// Triangle-wave mapper: signal sweeps [lo,hi] → joint bounces n times over
// [out_min, out_max] instead of mapping linearly.  n=1 → one full 70→110→70
// cycle; n=3 → three traversals so small signal changes produce rapid waving.
static float map_servo_bounce(float v, float lo, float hi,
                              float out_min, float out_max, int n) noexcept {
    if (hi - lo < 1e-6f) return (out_min + out_max) * 0.5f;
    float t = (v - lo) / (hi - lo);
    t = (t < 0.0f) ? 0.0f : (t > 1.0f ? 1.0f : t);
    float s = t * (float)n;               // position within [0, n]
    float f = fmodf(s, 1.0f);             // fractional part within segment
    int   seg = static_cast<int>(s);
    if (seg % 2 == 1) f = 1.0f - f;      // reverse direction on odd segments
    return out_min + f * (out_max - out_min);
}

// Convert a servo angle (0°…180°) to a PCA9685 pulse width in microseconds.
[[nodiscard]] static uint16_t deg_to_us(float deg) noexcept {
    const float t = deg * (1.0f / 180.0f);
    return static_cast<uint16_t>(SERVO_US_MIN + t * (SERVO_US_MAX - SERVO_US_MIN));
}

static void update_servos(int cluster) noexcept {
    // Driving signal for each joint (order matches SERVO_LO / SERVO_HI in header):
    //   S0 → spike_count        (base rotation — most expressive, snappy transients)
    //   S1 → PC3               (shoulder — slowest PCA component, safest constrained joint)
    //   S2 → PC1               (elbow — dominant posture axis, 45% variance)
    //   S3 → PC2               (wrist rotate — secondary posture, 22% variance)
    //   S4 → hjorth_complexity  (wrist tilt — most expressive, chaos bursts)
    const float driving[5] = {
        s_raw_feats[5],   // S0 ← spike_count
        s_pca[2],         // S1 ← PC3
        s_pca[0],         // S2 ← PC1
        s_pca[1],         // S3 ← PC2
        s_raw_feats[7],   // S4 ← hjorth_complexity
    };

    for (int j = 0; j < 5; ++j) {
        s_target_pos[j] = (SERVO_BOUNCES[j] > 0)
            ? map_servo_bounce(driving[j], SERVO_LO[j], SERVO_HI[j], JOINT_MIN[j], JOINT_MAX[j], SERVO_BOUNCES[j])
            : map_servo(driving[j], SERVO_LO[j], SERVO_HI[j], JOINT_MIN[j], JOINT_MAX[j]);
    }

    Serial.print("C:"); Serial.print(cluster);
    for (int j = 0; j < 5; ++j) {
        Serial.print("  S"); Serial.print(j);
        Serial.print(":"); Serial.print(static_cast<int>(s_servo_pos[j]));
    }
    Serial.print("    mean:");   Serial.print(s_raw_feats[0], 3);
    Serial.print("  spk:");     Serial.print(s_raw_feats[5], 4);
    Serial.print("  chaos:");   Serial.println(s_raw_feats[7], 3);
    Serial.print("  volts:"); Serial.println(volts, 4);

    // Serial.printf("{0:%.4f; 1:%.4f; 2:%.4f; 3:%.4f; 4:%d}\n",
                //   s_win_mean_v, s_raw_feats[1], s_raw_feats[5], s_raw_feats[7], cluster);
}

// ─────────────────────────────────────────────────────────────────────────────
// Arduino entry points
// ─────────────────────────────────────────────────────────────────────────────
void setup() {
    Serial.begin(115200);
    uint32_t now = millis();
    uint32_t ref_t = millis();
    while (!Serial) {
        if(ref_t - now > 500) break;
        ref_t = millis();
    }

    analogReadResolution(12);         // 0 – 4095
    analogSetAttenuation(ADC_11db);   // 0 – 3.3 V range

    Serial.println("Start init");
    Wire.begin(PIN_SDA, PIN_SCL);
    delay(1000);
    Serial.println("Scanning...");
    for (uint8_t addr = 1; addr < 127; addr++) {
        Wire.beginTransmission(addr);
        if (Wire.endTransmission() == 0) {
        Serial.print("Found device at 0x");
        Serial.println(addr, HEX);
        }
    }
    pwm.begin();
    pwm.sleep();
    delay(5);
    pwm.wakeup();
    pwm.setPWMFreq(50);
    delay(10);              // let oscillator settle
    static constexpr float STARTUP_POS[5] = {90.0f, 90.0f, 10.0f, 10.0f, 90.0f};
    Serial.println("Setting motors");
    for (int j = 0; j < 5; ++j)
        pwm.setPWM(SERVO_CHANNELS[j], 0, deg_to_pulse(STARTUP_POS[j]));
    delay(5000);

    Serial.println("Plantcasso inference ready.");
    Serial.print("k="); Serial.print(N_CLUSTERS);
    Serial.print("  window="); Serial.print(WINDOW_SIZE);
    Serial.print("  hop="); Serial.println(HOP_SIZE);
    Serial.println("C:cluster  S0-S4:servo_deg  mean  spk  chaos");
}

void loop() {
    // ── 100 Hz tick ───────────────────────────────────────────────────────
    static uint32_t last_us = 0;
    const  uint32_t now     = micros();
    if (now - last_us < SAMPLE_US) return;
    last_us = now;

    // ── Sample & filter ───────────────────────────────────────────────────
    raw_adc = analogRead(PIN_PLANT);
    volts   = raw_adc * (3.3f / 4095.0f);
    const float filt_v  = biquad_process(volts);

    // ── Write to circular buffer ──────────────────────────────────────────
    s_win_buf[s_write_pos] = filt_v;
    s_write_pos = (s_write_pos + 1) % WINDOW_SIZE;
    ++s_n_written;

    // ── Servo step every tick (100 Hz) ────────────────────────────────────
    // Runs unconditionally so motion is smooth between 300ms window updates.
    // Idle sinusoid adds gentle life; clamped so it cannot exceed joint limits.
    {
        const float t_s = millis() * 0.001f;
        for (int j = 0; j < 5; ++j) {
            const float idle = IDLE_AMP[j] * sinf(2.0f * (float)M_PI * IDLE_FREQ[j] * t_s + IDLE_PHASE[j]);
            float animated = s_target_pos[j] + idle;
            if (animated < JOINT_MIN[j]) animated = JOINT_MIN[j];
            if (animated > JOINT_MAX[j]) animated = JOINT_MAX[j];
            s_servo_pos[j] += SERVO_ALPHA[j] * (animated - s_servo_pos[j]);
            pwm.setPWM(SERVO_CHANNELS[j], 0, deg_to_pulse(s_servo_pos[j]));
        }
    }

    // ── Process window every HOP_SIZE samples once the buffer is full ─────
    if (s_n_written < static_cast<uint32_t>(WINDOW_SIZE)) return;
    if ((s_n_written - static_cast<uint32_t>(WINDOW_SIZE))
            % static_cast<uint32_t>(HOP_SIZE) != 0) return;

    // Place on stack — 100 × 4 bytes = 400 B, well within ESP32-S3 task stack.
    float temp_win[WINDOW_SIZE];
    linearise_window(temp_win);

    extract_features(temp_win, WINDOW_SIZE);
    standardise_and_project();
    const int cluster = find_cluster();
    update_servos(cluster);
}
